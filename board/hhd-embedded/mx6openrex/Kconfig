## board/hhd-embedded/mx6openrex/Kconfig
```kconfig
if TARGET_MX6OPENREX

config SYS_BOARD
	default "mx6openrex"

config SYS_VENDOR
	default "hhd-embedded"

config SYS_CONFIG_NAME
	default "mx6openrex"

endif
```
